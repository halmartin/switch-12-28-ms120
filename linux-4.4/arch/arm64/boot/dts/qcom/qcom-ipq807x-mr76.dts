
/dts-v1/;

#include "qcom-ipq807x-axe2x2.dtsi"

/ {
        model = "Meraki MR76";
	compatible = "qcom,ipq807x-hk09", "qcom,ipq807x";
};

&i2c_0 {
        current_mon: ina2xx@40 {
                shunt-resistor = <32000>;
        };
};
